## drivers/custom/Kconfig
```kconfig
#******************************************************************************************
# @file    Kconfig
# @brief   Kconfig file for a custom out of tree driver driver class 
# @spdx_license_identifier: Apache-2.0
#******************************************************************************************

menuconfig CUSTOM

config CUSTOM
	bool "enable Custom Driver Class"
	help
	  This option enables the custom driver class.

if CUSTOM

	config CUSTOM_INIT_PRIORITY
		int "Custom device drivers init priority"
		default KERNEL_INIT_PRIORITY_DEVICE
		help
		Custom drivers init priority.

	config CUSTOM_LOG_LVL
		int "Custom device drivers log level"
		default LOG_LEVEL_INF
		help
		Custom drivers log level.
		0 = None, 1 = Error, 2 = Warning, 3 = Info, 4 = Debug, 5 = Trace

	rsource "custom_device/Kconfig"
endif # CUSTOM
```

## drivers/custom/custom_device/Kconfig
```kconfig
#******************************************************************************************
# @file    Kconfig
# @brief   Kconfig file for a custom out of tree driver driver class 
# @spdx_license_identifier: Apache-2.0
#******************************************************************************************

config CUSTOM_DEVICE
    bool "enable Custom Device"
	help
	  enable the custom device.
```

## dts/bindings/template_binding/template.yaml
```yaml
#******************************************************************************************
# @file    template.yaml
# @brief   YAML file for a custom out of tree Devicetree binding
# @spdx_license_identifier: Apache-2.0
#******************************************************************************************/

description: |
  A template for a custom Devicetree binding. 

compatible: "zephyr,template"

include: base.yaml

properties:
  example-button:
    type: phandle-array
    required: true
    description: example button that must be defined in the devicetree node.

  example-property:
    type: int
    required: true
    description: An example property that must be defined in the devicetree node.

  optional-property:
    type: string
    description: An optional property that can be defined in the devicetree node.
```
